## build.sample/conf/bblayers.conf
```bitbake
# LAYER_CONF_VERSION is increased each time build/conf/bblayers.conf
# changes incompatibly
LCONF_VERSION = "4"

BBFILES ?= ""
BBLAYERS ?= " \
  /media/OE/poky/poky/meta \
  /media/OE/poky/poky/meta-yocto \
  /media/OE/poky/poky/meta-openembedded/meta-oe \
  /media/OE/poky/poky/meta-angstrom \
  /media/OE/poky/poky/meta-ettus \
  "
```
